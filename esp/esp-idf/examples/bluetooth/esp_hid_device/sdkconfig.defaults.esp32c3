## esp/esp-idf/examples/bluetooth/esp_hid_device/sdkconfig.defaults.esp32c3
```kconfig
CONFIG_BT_ENABLED=y
CONFIG_BT_BLUEDROID_ENABLED=y
CONFIG_BT_BLE_ENABLED=y
CONFIG_BT_BLE_42_FEATURES_SUPPORTED=y
CONFIG_BT_NIMBLE_ENABLED=y
CONFIG_EXAMPLE_HID_DEVICE_ROLE=3
```

## esp/esp-idf/examples/get-started/blink/sdkconfig.defaults.esp32c3
```kconfig
# CONFIG_BLINK_LED_STRIP=y
CONFIG_BLINK_LED_STRIP=n
CONFIG_BLINK_GPIO=7
CONFIG_BLINK_LED_GPIO=y
```

## esp/esp-idf/examples/protocols/https_request/sdkconfig.defaults
```kconfig
CONFIG_MBEDTLS_HAVE_TIME_DATE=y
CONFIG_LWIP_SNTP_MAX_SERVERS=2
CONFIG_PARTITION_TABLE_SINGLE_APP_LARGE=y
CONFIG_EXAMPLE_WIFI__SSID="Christian's iPhone (2)"
CONFIG_EXAMPLE_WIFI_PASSWORD="4082428889"
```
