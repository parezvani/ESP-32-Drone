## main/firmware/gps_telemetry/main/Kconfig.projbuild
```kconfig
menu "FireFly GPS Broadcaster"

    config GPS_DRONE_ID
        string "Drone ID"
        default "drone_1"
        help
            Unique identifier for this drone. Sent in the "id" field of
            every UDP broadcast and cloud POST. Must match the drone
            entry registered on the dashboard. Change before flashing
            each board (e.g. "drone_1", "kenny_drone").

    config GPS_WIFI_SSID
        string "WiFi SSID"
        default "myssid"

    config GPS_WIFI_PASSWORD
        string "WiFi Password"
        default "mypassword"

    config GPS_UDP_PORT
        int "UDP broadcast port (local network)"
        default 4210

    config GPS_CLOUD_ENABLED
        bool "Enable HTTPS POST to cloud server"
        default n
        help
            When enabled, every GPS fix is also POSTed to the cloud server
            in addition to being broadcast over UDP. Requires GPS_CLOUD_URL
            and GPS_API_KEY to be set.

    config GPS_CLOUD_URL
        string "Cloud HTTPS endpoint"
        depends on GPS_CLOUD_ENABLED
        default "https://firefly-team6.onrender.com/api/drone"
        help
            Full HTTPS URL the firmware POSTs telemetry to.

    config GPS_API_KEY
        string "API key for cloud endpoint"
        depends on GPS_CLOUD_ENABLED
        default ""
        help
            Long random string registered in the cloud dashboard. Sent in
            the X-API-Key header. Treat as a secret.

endmenu
```
